## package/network/services/nginx-rtmp-server/Config.in
```kconfig
#
# Copyright (C) 2010-2016 OpenWrt.org
#
# This is free software, licensed under the GNU General Public License v2.
# See /LICENSE for more information.
#

menu "Configuration"
        depends on PACKAGE_nginx-rtmp-server

config NGINX_SSL
	bool
	prompt "Enable SSL module"
	help
		Enable HTTPS/SSL support.
	default y

config NGINX_RTMP_MODULE
	bool
	prompt "Enable RTMP module"
	depends on NGINX_SSL
	help
		Add support for NGINX-based Media Streaming Server module.
	default y


endmenu
```

## package/siflower/siflowerkernel/sf-ts/src/Kconfig
```kconfig
config SIFLOWER_TS
	tristate "Siflower traffic statistics"

if SIFLOWER_TS
menu SIFLOWER_FUNCTION
	config SF_QOS
	bool siflower qos

	config SF_PKT_SEND_BY_KERNEL
	bool send packet by kernel client
endmenu
endif
```

## target/linux/ar71xx/files/sound/soc/ath79/Kconfig
```kconfig
#
# Copyright (c) 2013 Qualcomm Atheros, Inc.
#
# Permission to use, copy, modify, and/or distribute this software for any
# purpose with or without fee is hereby granted, provided that the above
# copyright notice and this permission notice appear in all copies.
#
# THE SOFTWARE IS PROVIDED "AS IS" AND THE AUTHOR DISCLAIMS ALL WARRANTIES
# WITH REGARD TO THIS SOFTWARE INCLUDING ALL IMPLIED WARRANTIES OF
# MERCHANTABILITY AND FITNESS. IN NO EVENT SHALL THE AUTHOR BE LIABLE FOR
# ANY SPECIAL, DIRECT, INDIRECT, OR CONSEQUENTIAL DAMAGES OR ANY DAMAGES
# WHATSOEVER RESULTING FROM LOSS OF USE, DATA OR PROFITS, WHETHER IN AN
# ACTION OF CONTRACT, NEGLIGENCE OR OTHER TORTIOUS ACTION, ARISING OUT OF
# OR IN CONNECTION WITH THE USE OR PERFORMANCE OF THIS SOFTWARE.

config SND_ATH79_SOC
	tristate "SoC Audio for ath79"
	help
	  Say Y or M if you want to add support for ath79 platforms
	  You will also need to select the board in the options below.

config SND_ATH79_SOC_I2S
	tristate "SoC Audio for ath79 i2s-bus"

config SND_ATH79_SOC_CODEC
	tristate "SoC Audio for ath79 codec"

config SND_ATH79_SOC_DB120
	tristate "SoC Audio support for QCA Reference design DB120"
	depends on SND_ATH79_SOC
	select SND_ATH79_SOC_I2S
	select SND_ATH79_SOC_CODEC
	help
	  Say Y if you want to add support for SoC audio on DB120
	  Qualcomm-Atheros reference design. This option enables the
	  DB12x machine support, ath79 PCM engine, I2S interface and internal
	  codec.

config SND_ATH79_SOC_DB120_AK4430
	tristate "SoC Audio support for QCA Reference design DB120 with AK4430"
	depends on SND_ATH79_SOC
	select SND_ATH79_SOC_I2S
	select SND_SOC_AK4430
	select SND_ATH79_SOC_CODEC
	help
	  Say Y if you want to add support for SoC audio on DB120
	  Qualcomm-Atheros reference design. This option enables the
	  DB12x-AK4430 machine support, ath79 PCM engine, I2S
	  interface, internal codec and AK4430 codec.

config SND_ATH79_SOC_AP123_AK4430
	tristate "SoC Audio support for QCA Reference design AP123 with AK4430"
	depends on SND_ATH79_SOC
	select SND_ATH79_SOC_I2S
	select SND_SOC_AK4430
	select SND_ATH79_SOC_CODEC
	help
	  Say Y if you want to add support for SoC audio on AP123
	  Qualcomm-Atheros reference design. This option enables the
	  AP123-AK4430 machine support, ath79 PCM engine, I2S
	  interface, internal codec and AK4430 codec.

config SND_ATH79_SOC_AP123_TB388
	tristate "SoC Audio support for QCA Reference design AP123 with TB388"
	depends on SND_ATH79_SOC
	select SND_ATH79_SOC_I2S
	select SND_ATH79_SOC_CODEC
	help
	  Say Y if you want to add support for SoC audio on AP123
	  Qualcomm-Atheros reference design. This option enables the
	  AP123-TB388 machine support, ath79 PCM engine, I2S
	  interface and internal codec.

config SND_ATH79_SOC_FON2415
	tristate "SoC Audio support for FON2415"
	depends on SND_ATH79_SOC
	select SND_ATH79_SOC_I2S
	select SND_SOC_AK4430
	select SND_ATH79_SOC_CODEC
	help
	  Say Y if you want to add support for SoC audio on FON2415
	  Fonera HUB/Juke/Gramofon/... board. This option enables the
	  FON2415 machine support, ath79 PCM engine, I2S
	  interface, internal codec and AK4430 codec.

config SND_ATH79_SOC_CUS227
	tristate "SoC  Audio support for CUS227 board"
	depends on SND_ATH79_SOC
	select SND_ATH79_SOC_I2S
	select SND_SOC_WM8988
	help
	  Say Y if you want to add support for SoC audio on DB120
	  Qualcomm-Atheros reference design. This option enables the
	  CUS227 machine support, ath79 PCM engine, I2S interface and internal
	  codec.

config SND_ATH79_SOC_WMB001N
	tristate "SoC  Audio support for WMB001N board"
	depends on SND_ATH79_SOC
	select SND_ATH79_SOC_I2S
	select SND_SOC_WM8904
	select SND_ATH79_SOC_CODEC
	help
	  Not tested.  

#  KCONFIG:= \
#	CONFIG_SND=y \
#	CONFIG_SND_ATH79_SOC_CODEC=y \
#	CONFIG_SND_ATH79_SOC_I2S=y \
#	CONFIG_SND_COMPRESS_OFFLOAD=y \
#	CONFIG_SND_PCM=y \
#	CONFIG_SND_SOC=y \
#	CONFIG_SND_SOC_WM8904=y \
#	CONFIG_SND_SOC_I2C_AND_SPI=y \
#	CONFIG_SND_TIMER=y \
#	CONFIG_SOUND=y \
#	CONFIG_ATH79_DEV_AUDIO=y \
#	CONFIG_SND_ATH79_SOC=y \
#	CONFIG_SND_ATH79_SOC_WMB001N=y
#  FILES:= \
#	$(LINUX_DIR)/sound/soc/ath79/snd-soc-ath79-i2s.ko \
#	$(LINUX_DIR)/sound/soc/ath79/snd-soc-ath79-pcm.ko \
#	$(LINUX_DIR)/sound/soc/ath79/snd-soc-ath79-codec.ko \
#	$(LINUX_DIR)/sound/soc/ath79/snd-soc-wmb001n.ko \
#	$(LINUX_DIR)/sound/soc/codecs/snd-soc-wm8904.ko
```

## target/linux/generic/files/net/fast-classifier/Kconfig
```kconfig
#
# Shortcut forwarding engine
#

config FAST_CLASSIFIER
	tristate "Shortcut Forwarding Engine"
	depends on SHORTCUT_FE
	default y
	---help---
	  Shortcut is a fast in-kernel packet forwarding engine.

	  To compile this code as a module, choose M here: the module will be
	  called shortcut-fe.

	  If unsure, say N.
```
